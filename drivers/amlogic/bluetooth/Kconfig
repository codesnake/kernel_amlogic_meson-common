## drivers/amlogic/bluetooth/Kconfig
```kconfig
menu "Bluetooth Device Support"

config BT_DEVICE
    bool "BT Device support"
    depends on BT && RFKILL
    select BACKLIGHT_CLASS_DEVICE
    default n
    help
      Say Y here if you want to use the BT device.

endmenu
```

## drivers/amlogic/ionvideo/Kconfig
```kconfig
menu "Amlogic ion video support"

config AMLOGIC_IONVIDEO
	tristate "Amlogic ion video device support"
	select VIDEO_DEV
	select VIDEO_V4L2
	select VIDEOBUF2_CORE
	select VIDEOBUF2_MEMOPS
	select DMA_SHARED_BUFFER
	default n

	---help---
	capture ion video to user
endmenu
```
